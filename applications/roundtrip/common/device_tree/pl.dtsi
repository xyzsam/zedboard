/*
 * CAUTION: This file is automatically generated by Xilinx.
 * Version: HSI 2015.1
 * Today is: Mon Feb 22 15:07:47 2016
*/


/ {
	amba_pl: amba_pl {
		#address-cells = <1>;
		#size-cells = <1>;
		compatible = "simple-bus";
		ranges ;
		roundtrip_static_reg_0: roundtrip_static_reg@43c00000 {
			compatible = "xlnx,roundtrip-static-reg-1.0", "generic-uio";
			interrupt-parent = <&intc>;
			interrupts = <0 29 4>;
			reg = <0x43c00000 0x10000>;
			xlnx,s-axi-bus-a-addr-width = <0x5>;
			xlnx,s-axi-bus-a-data-width = <0x20>;
		};
	};
};
